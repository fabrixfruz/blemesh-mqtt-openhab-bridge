## sdkconfig.defaults
```kconfig
CONFIG_BT_ENABLED=y
CONFIG_BT_BLE_ENABLED=y
CONFIG_BT_MESH_PROVISIONER=y
CONFIG_BT_MESH_LOW_POWER=n
CONFIG_BT_MESH_RELAY=y
CONFIG_BT_MESH_GATT_PROXY_SERVER=y
CONFIG_BT_MESH_MODEL=y
CONFIG_BT_MESH_CFG_CLI=y
CONFIG_BT_MESH_GENERIC_ONOFF_CLI=y
```
